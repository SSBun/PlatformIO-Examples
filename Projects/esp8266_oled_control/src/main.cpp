#include <Wire.h>
#include <Arduino.h>
#include <SSD1306Wire.h>

 // Initialize the OLED display using Wire library
 SSD1306Wire  display(0x3c, D3, D5, GEOMETRY_128_32);
 // SH1106 display(0x3c, D3, D5);

 extern const char Special_Elite_Regular_20[];

// Adapted from Adafruit_SSD1306
void drawLines() {
  for (int16_t i=0; i<display.getWidth(); i+=4) {
    display.drawLine(0, 0, i, display.getHeight()-1);
    display.display();
    delay(10);
  }
  for (int16_t i=0; i<display.getHeight(); i+=4) {
    display.drawLine(0, 0, display.getWidth()-1, i);
    display.display();
    delay(10);
  }
  delay(250);

  display.clear();
  for (int16_t i=0; i<display.getWidth(); i+=4) {
    display.drawLine(0, display.getHeight()-1, i, 0);
    display.display();
    delay(10);
  }
  for (int16_t i=display.getHeight()-1; i>=0; i-=4) {
    display.drawLine(0, display.getHeight()-1, display.getWidth()-1, i);
    display.display();
    delay(10);
  }
  delay(250);

  display.clear();
  for (int16_t i=display.getWidth()-1; i>=0; i-=4) {
    display.drawLine(display.getWidth()-1, display.getHeight()-1, i, 0);
    display.display();
    delay(10);
  }
  for (int16_t i=display.getHeight()-1; i>=0; i-=4) {
    display.drawLine(display.getWidth()-1, display.getHeight()-1, 0, i);
    display.display();
    delay(10);
  }
  delay(250);
  display.clear();
  for (int16_t i=0; i<display.getHeight(); i+=4) {
    display.drawLine(display.getWidth()-1, 0, 0, i);
    display.display();
    delay(10);
  }
  for (int16_t i=0; i<display.getWidth(); i+=4) {
    display.drawLine(display.getWidth()-1, 0, i, display.getHeight()-1);
    display.display();
    delay(10);
  }
  delay(250);
}

// Adapted from Adafruit_SSD1306
void drawRect(void) {
  for (int16_t i=0; i<display.getHeight()/2; i+=2) {
    display.drawRect(i, i, display.getWidth()-2*i, display.getHeight()-2*i);
    display.display();
    delay(10);
  }
}

// Adapted from Adafruit_SSD1306
void fillRect(void) {
  uint8_t color = 1;
  for (int16_t i=0; i<display.getHeight()/2; i+=3) {
    display.setColor((color % 2 == 0) ? BLACK : WHITE); // alternate colors
    display.fillRect(i, i, display.getWidth() - i*2, display.getHeight() - i*2);
    display.display();
    delay(10);
    color++;
  }
  // Reset back to WHITE
  display.setColor(WHITE);
}

// Adapted from Adafruit_SSD1306
void drawCircle(void) {
  for (int16_t i=0; i<display.getHeight(); i+=2) {
    display.drawCircle(display.getWidth()/2, display.getHeight()/2, i);
    display.display();
    delay(10);
  }
  delay(1000);
  display.clear();

  // This will draw the part of the circel in quadrant 1
  // Quadrants are numberd like this:
  //   0010 | 0001
  //  ------|-----
  //   0100 | 1000
  //
  display.drawCircleQuads(display.getWidth()/2, display.getHeight()/2, display.getHeight()/4, 0b00000001);
  display.display();
  delay(200);
  display.drawCircleQuads(display.getWidth()/2, display.getHeight()/2, display.getHeight()/4, 0b00000011);
  display.display();
  delay(200);
  display.drawCircleQuads(display.getWidth()/2, display.getHeight()/2, display.getHeight()/4, 0b00000111);
  display.display();
  delay(200);
  display.drawCircleQuads(display.getWidth()/2, display.getHeight()/2, display.getHeight()/4, 0b00001111);
  display.display();
}

void printBuffer(void) {
  // Initialize the log buffer
  // allocate memory to store 8 lines of text and 30 chars per line.
  display.setFont(ArialMT_Plain_10);
  // display.setLogBuffer(1, 30);

  // Some test data
  const char* test[] = {
      "Hello",
      "World" ,
      "----",
      "Show off",
      "how",
      "the log buffer",
      "is",
      "working.",
      "Even",
      "scrolling is",
      "working"
  };

  for (uint8_t i = 0; i < 11; i++) {
    display.clear();
    display.drawString(0, 0, test[i]);
    // display.clear();
    // Print to the screen
    // display.println(test[i]);
    // Draw it to the internal screen buffer
    // display.drawLogBuffer(0, 0);
    // Display it on the screen
    // display.display();
    delay(500);
  }
}

void setup() {
  Serial.begin(9600);
  display.init();

  display.flipScreenVertically();

  display.setContrast(255);  

  display.setFont((const uint8_t *)(Special_Elite_Regular_20));

  delay(500);
  
  Serial.print("screen widtH: ");
  Serial.println(display.getWidth());
  Serial.println("screen height: ");
  Serial.println(display.getHeight());

  // drawLines();
  // delay(1000);
  // display.clear();

  // drawRect();
  // delay(1000);
  // display.clear();

  // fillRect();
  // delay(1000);
  // display.clear();

  // drawCircle();
  // delay(1000);
  // display.clear();

  // printBuffer();
  // delay(1000);
  // display.clear();
}

void log(const String& msg) {
  display.clear();
  display.drawString(0, 0, msg);
  display.display();
}

void loop() { 
  if (Serial.available()) {
    log(Serial.readString());
  }
}

// Created by http://oleddisplay.squix.ch/ Consider a donation
// In case of problems make sure that you are using the font file with the correct version!
const char Special_Elite_Regular_20[] PROGMEM = {
	0x12, // Width: 18
	0x15, // Height: 21
	0x20, // First Char: 32
	0xE0, // Numbers of Chars: 224

	// Jump Table:
	0xFF, 0xFF, 0x00, 0x06,  // 32:65535
	0x00, 0x00, 0x0B, 0x06,  // 33:0
	0x00, 0x0B, 0x10, 0x07,  // 34:11
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	0x15, 0x6B, 0x22, 0x0C,  // 255:5483

	// Font Data:
	0x00,0x00,0x00,0x00,0x20,0x00,0xFE,0x67,0x00,0xFE,0x61,	// 33
	0x00,0x00,0x00,0x1E,0x00,0x00,0x3E,0x00,0x00,0x00,0x00,0x00,0x3E,0x00,0x00,0x3E,	// 34
	0x00,0x00,0x00,0x40,0x62,0x00,0x40,0x3E,0x00,0xC0,0x07,0x00,0xF8,0x02,0x00,0x5E,0x7A,0x00,0x42,0x0E,0x00,0xE0,0x03,0x00,0x7E,0x02,0x00,0x46,0x02,	// 35
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	0x40,0x00,0x03,0x40,0x80,0x07,0x40,0x00,0x07,0xCC,0x01,0x0F,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0x00,0x40	// 255
};
